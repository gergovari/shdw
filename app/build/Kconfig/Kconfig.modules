## app/build/Kconfig/Kconfig.modules
```kconfig
menu "example-application (/home/oJis/Documents/projects/zephyr/shd/shd/example-application)"
osource "/home/oJis/Documents/projects/zephyr/shd/shd/example-application/Kconfig"
config ZEPHYR_EXAMPLE_APPLICATION_MODULE
	bool
	default y
endmenu
menu "hal_espressif (/home/oJis/Documents/projects/zephyr/shd/shd/modules/hal/espressif)"
osource "/home/oJis/Documents/projects/zephyr/shd/shd/modules/hal/espressif/zephyr/Kconfig"
config ZEPHYR_HAL_ESPRESSIF_MODULE
	bool
	default y

config ZEPHYR_HAL_ESPRESSIF_MODULE_BLOBS
	bool
endmenu
menu "lvgl (/home/oJis/Documents/projects/zephyr/shd/shd/modules/lib/gui/lvgl)"
osource "/home/oJis/Documents/projects/zephyr/shd/shd/modules/lib/gui/lvgl/zephyr/Kconfig"
config ZEPHYR_LVGL_MODULE
	bool
	default y
endmenu
```

## app/build/Kconfig/Kconfig.shield
```kconfig
osource "/home/oJis/Documents/projects/zephyr/shd/shd/example-application/boards/shields/*/Kconfig.shield"
```

## app/build/Kconfig/Kconfig.sysbuild.modules
```kconfig
config ZEPHYR_EXAMPLE_APPLICATION_MODULE
   bool
   default y
config ZEPHYR_HAL_ESPRESSIF_MODULE
   bool
   default y
config ZEPHYR_LVGL_MODULE
   bool
   default y
```

## app/build/Kconfig/arch/Kconfig
```kconfig
# Load Zephyr Arch Kconfig descriptions.
osource "/home/oJis/Documents/projects/zephyr/shd/shd/zephyr/arch/x86/Kconfig"
osource "/home/oJis/Documents/projects/zephyr/shd/shd/zephyr/arch/xtensa/Kconfig"
osource "/home/oJis/Documents/projects/zephyr/shd/shd/zephyr/arch/sparc/Kconfig"
osource "/home/oJis/Documents/projects/zephyr/shd/shd/zephyr/arch/riscv/Kconfig"
osource "/home/oJis/Documents/projects/zephyr/shd/shd/zephyr/arch/posix/Kconfig"
osource "/home/oJis/Documents/projects/zephyr/shd/shd/zephyr/arch/nios2/Kconfig"
osource "/home/oJis/Documents/projects/zephyr/shd/shd/zephyr/arch/mips/Kconfig"
osource "/home/oJis/Documents/projects/zephyr/shd/shd/zephyr/arch/arm64/Kconfig"
osource "/home/oJis/Documents/projects/zephyr/shd/shd/zephyr/arch/arm/Kconfig"
osource "/home/oJis/Documents/projects/zephyr/shd/shd/zephyr/arch/arc/Kconfig"
```

## app/build/Kconfig/boards/Kconfig.defconfig
```kconfig
# Load Zephyr board defconfig descriptions.
osource "/home/oJis/Documents/projects/zephyr/shd/shd/zephyr/boards/espressif/esp_wrover_kit/Kconfig.defconfig"
```

## app/build/Kconfig/boards/Kconfig.esp_wrover_kit
```kconfig
# Load board Kconfig descriptions.
osource "/home/oJis/Documents/projects/zephyr/shd/shd/zephyr/boards/espressif/esp_wrover_kit/Kconfig.esp_wrover_kit"
```

## app/build/Kconfig/soc/Kconfig
```kconfig
# Load Zephyr SoC Kconfig descriptions.
osource "/home/oJis/Documents/projects/zephyr/shd/shd/zephyr/soc/xlnx/zynqmp/Kconfig"
osource "/home/oJis/Documents/projects/zephyr/shd/shd/zephyr/soc/xlnx/zynq7000/Kconfig"
osource "/home/oJis/Documents/projects/zephyr/shd/shd/zephyr/soc/xen/Kconfig"
osource "/home/oJis/Documents/projects/zephyr/shd/shd/zephyr/soc/wch/ch32v/Kconfig"
osource "/home/oJis/Documents/projects/zephyr/shd/shd/zephyr/soc/ti/simplelink/Kconfig"
osource "/home/oJis/Documents/projects/zephyr/shd/shd/zephyr/soc/ti/lm3s6965/Kconfig"
osource "/home/oJis/Documents/projects/zephyr/shd/shd/zephyr/soc/ti/k3/Kconfig"
osource "/home/oJis/Documents/projects/zephyr/shd/shd/zephyr/soc/telink/tlsr/Kconfig"
osource "/home/oJis/Documents/projects/zephyr/shd/shd/zephyr/soc/starfive/jh71xx/Kconfig"
osource "/home/oJis/Documents/projects/zephyr/shd/shd/zephyr/soc/st/stm32/Kconfig"
osource "/home/oJis/Documents/projects/zephyr/shd/shd/zephyr/soc/snps/qemu_arc/Kconfig"
osource "/home/oJis/Documents/projects/zephyr/shd/shd/zephyr/soc/snps/nsim/arc_v/Kconfig"
osource "/home/oJis/Documents/projects/zephyr/shd/shd/zephyr/soc/snps/nsim/arc_classic/Kconfig"
osource "/home/oJis/Documents/projects/zephyr/shd/shd/zephyr/soc/snps/hsdk4xd/Kconfig"
osource "/home/oJis/Documents/projects/zephyr/shd/shd/zephyr/soc/snps/hsdk/Kconfig"
osource "/home/oJis/Documents/projects/zephyr/shd/shd/zephyr/soc/snps/emsk/Kconfig"
osource "/home/oJis/Documents/projects/zephyr/shd/shd/zephyr/soc/snps/emsdp/Kconfig"
osource "/home/oJis/Documents/projects/zephyr/shd/shd/zephyr/soc/snps/arc_iot/Kconfig"
osource "/home/oJis/Documents/projects/zephyr/shd/shd/zephyr/soc/silabs/Kconfig"
osource "/home/oJis/Documents/projects/zephyr/shd/shd/zephyr/soc/sifive/sifive_freedom/Kconfig"
osource "/home/oJis/Documents/projects/zephyr/shd/shd/zephyr/soc/sensry/Kconfig"
osource "/home/oJis/Documents/projects/zephyr/shd/shd/zephyr/soc/rockchip/Kconfig"
osource "/home/oJis/Documents/projects/zephyr/shd/shd/zephyr/soc/renode/riscv_virtual/Kconfig"
osource "/home/oJis/Documents/projects/zephyr/shd/shd/zephyr/soc/renode/cortex_r8_virtual/Kconfig"
osource "/home/oJis/Documents/projects/zephyr/shd/shd/zephyr/soc/renesas/smartbond/Kconfig"
osource "/home/oJis/Documents/projects/zephyr/shd/shd/zephyr/soc/renesas/rzt2m/Kconfig"
osource "/home/oJis/Documents/projects/zephyr/shd/shd/zephyr/soc/renesas/rz/Kconfig"
osource "/home/oJis/Documents/projects/zephyr/shd/shd/zephyr/soc/renesas/rcar/Kconfig"
osource "/home/oJis/Documents/projects/zephyr/shd/shd/zephyr/soc/renesas/ra/Kconfig"
osource "/home/oJis/Documents/projects/zephyr/shd/shd/zephyr/soc/realtek/ec/Kconfig"
osource "/home/oJis/Documents/projects/zephyr/shd/shd/zephyr/soc/raspberrypi/rpi_pico/Kconfig"
osource "/home/oJis/Documents/projects/zephyr/shd/shd/zephyr/soc/quicklogic/eos_s3/Kconfig"
osource "/home/oJis/Documents/projects/zephyr/shd/shd/zephyr/soc/qemu/virt_riscv/Kconfig"
osource "/home/oJis/Documents/projects/zephyr/shd/shd/zephyr/soc/qemu/malta/Kconfig"
osource "/home/oJis/Documents/projects/zephyr/shd/shd/zephyr/soc/openisa/rv32m1/Kconfig"
osource "/home/oJis/Documents/projects/zephyr/shd/shd/zephyr/soc/nxp/s32/Kconfig"
osource "/home/oJis/Documents/projects/zephyr/shd/shd/zephyr/soc/nxp/rw/Kconfig"
osource "/home/oJis/Documents/projects/zephyr/shd/shd/zephyr/soc/nxp/mcx/Kconfig"
osource "/home/oJis/Documents/projects/zephyr/shd/shd/zephyr/soc/nxp/lpc/Kconfig"
osource "/home/oJis/Documents/projects/zephyr/shd/shd/zephyr/soc/nxp/layerscape/Kconfig"
osource "/home/oJis/Documents/projects/zephyr/shd/shd/zephyr/soc/nxp/kinetis/Kconfig"
osource "/home/oJis/Documents/projects/zephyr/shd/shd/zephyr/soc/nxp/imxrt/Kconfig"
osource "/home/oJis/Documents/projects/zephyr/shd/shd/zephyr/soc/nxp/imx/Kconfig"
osource "/home/oJis/Documents/projects/zephyr/shd/shd/zephyr/soc/nuvoton/numicro/Kconfig"
osource "/home/oJis/Documents/projects/zephyr/shd/shd/zephyr/soc/nuvoton/numaker/Kconfig"
osource "/home/oJis/Documents/projects/zephyr/shd/shd/zephyr/soc/nuvoton/npcx/Kconfig"
osource "/home/oJis/Documents/projects/zephyr/shd/shd/zephyr/soc/nuvoton/npcm/Kconfig"
osource "/home/oJis/Documents/projects/zephyr/shd/shd/zephyr/soc/nordic/Kconfig"
osource "/home/oJis/Documents/projects/zephyr/shd/shd/zephyr/soc/neorv32/Kconfig"
osource "/home/oJis/Documents/projects/zephyr/shd/shd/zephyr/soc/native/inf_clock/Kconfig"
osource "/home/oJis/Documents/projects/zephyr/shd/shd/zephyr/soc/microchip/miv/Kconfig"
osource "/home/oJis/Documents/projects/zephyr/shd/shd/zephyr/soc/microchip/mec/Kconfig"
osource "/home/oJis/Documents/projects/zephyr/shd/shd/zephyr/soc/mediatek/mt8xxx/Kconfig"
osource "/home/oJis/Documents/projects/zephyr/shd/shd/zephyr/soc/lowrisc/opentitan/Kconfig"
osource "/home/oJis/Documents/projects/zephyr/shd/shd/zephyr/soc/litex/litex_vexriscv/Kconfig"
osource "/home/oJis/Documents/projects/zephyr/shd/shd/zephyr/soc/ite/ec/Kconfig"
osource "/home/oJis/Documents/projects/zephyr/shd/shd/zephyr/soc/intel/raptor_lake/Kconfig"
osource "/home/oJis/Documents/projects/zephyr/shd/shd/zephyr/soc/intel/lakemont/Kconfig"
osource "/home/oJis/Documents/projects/zephyr/shd/shd/zephyr/soc/intel/intel_socfpga_std/Kconfig"
osource "/home/oJis/Documents/projects/zephyr/shd/shd/zephyr/soc/intel/intel_socfpga/Kconfig"
osource "/home/oJis/Documents/projects/zephyr/shd/shd/zephyr/soc/intel/intel_niosv/Kconfig"
osource "/home/oJis/Documents/projects/zephyr/shd/shd/zephyr/soc/intel/intel_ish/Kconfig"
osource "/home/oJis/Documents/projects/zephyr/shd/shd/zephyr/soc/intel/intel_adsp/Kconfig"
osource "/home/oJis/Documents/projects/zephyr/shd/shd/zephyr/soc/intel/elkhart_lake/Kconfig"
osource "/home/oJis/Documents/projects/zephyr/shd/shd/zephyr/soc/intel/atom/Kconfig"
osource "/home/oJis/Documents/projects/zephyr/shd/shd/zephyr/soc/intel/apollo_lake/Kconfig"
osource "/home/oJis/Documents/projects/zephyr/shd/shd/zephyr/soc/intel/alder_lake/Kconfig"
osource "/home/oJis/Documents/projects/zephyr/shd/shd/zephyr/soc/infineon/cat3/Kconfig"
osource "/home/oJis/Documents/projects/zephyr/shd/shd/zephyr/soc/infineon/cat1b/Kconfig"
osource "/home/oJis/Documents/projects/zephyr/shd/shd/zephyr/soc/infineon/cat1a/Kconfig"
osource "/home/oJis/Documents/projects/zephyr/shd/shd/zephyr/soc/gd/gd32/Kconfig"
osource "/home/oJis/Documents/projects/zephyr/shd/shd/zephyr/soc/gaisler/leon3/Kconfig"
osource "/home/oJis/Documents/projects/zephyr/shd/shd/zephyr/soc/gaisler/gr716a/Kconfig"
osource "/home/oJis/Documents/projects/zephyr/shd/shd/zephyr/soc/espressif/Kconfig"
osource "/home/oJis/Documents/projects/zephyr/shd/shd/zephyr/soc/ene/kb1200/Kconfig"
osource "/home/oJis/Documents/projects/zephyr/shd/shd/zephyr/soc/efinix/sapphire/Kconfig"
osource "/home/oJis/Documents/projects/zephyr/shd/shd/zephyr/soc/cdns/xtensa_sample_controller/Kconfig"
osource "/home/oJis/Documents/projects/zephyr/shd/shd/zephyr/soc/cdns/sample_controller32/Kconfig"
osource "/home/oJis/Documents/projects/zephyr/shd/shd/zephyr/soc/cdns/dc233c/Kconfig"
osource "/home/oJis/Documents/projects/zephyr/shd/shd/zephyr/soc/brcm/bcmvk/Kconfig"
osource "/home/oJis/Documents/projects/zephyr/shd/shd/zephyr/soc/brcm/bcm2712/Kconfig"
osource "/home/oJis/Documents/projects/zephyr/shd/shd/zephyr/soc/brcm/bcm2711/Kconfig"
osource "/home/oJis/Documents/projects/zephyr/shd/shd/zephyr/soc/atmel/sam0/Kconfig"
osource "/home/oJis/Documents/projects/zephyr/shd/shd/zephyr/soc/atmel/sam/Kconfig"
osource "/home/oJis/Documents/projects/zephyr/shd/shd/zephyr/soc/aspeed/Kconfig"
osource "/home/oJis/Documents/projects/zephyr/shd/shd/zephyr/soc/arm/Kconfig"
osource "/home/oJis/Documents/projects/zephyr/shd/shd/zephyr/soc/arm/beetle/Kconfig"
osource "/home/oJis/Documents/projects/zephyr/shd/shd/zephyr/soc/antmicro/myra/Kconfig"
osource "/home/oJis/Documents/projects/zephyr/shd/shd/zephyr/soc/andestech/Kconfig"
osource "/home/oJis/Documents/projects/zephyr/shd/shd/zephyr/soc/amd/acp_6_0/Kconfig"
osource "/home/oJis/Documents/projects/zephyr/shd/shd/zephyr/soc/ambiq/Kconfig"
osource "/home/oJis/Documents/projects/zephyr/shd/shd/zephyr/soc/altr/zephyr_nios2f/Kconfig"
osource "/home/oJis/Documents/projects/zephyr/shd/shd/zephyr/soc/altr/qemu_nios2/Kconfig"
osource "/home/oJis/Documents/projects/zephyr/shd/shd/zephyr/soc/adi/max32/Kconfig"
```
