## app/build/Kconfig/soc/Kconfig.sysbuild
```kconfig
# Load Sysbuild SoC Kconfig descriptions.
osource "/home/oJis/Documents/projects/zephyr/shd/shd/zephyr/soc/xlnx/zynqmp/Kconfig.sysbuild"
osource "/home/oJis/Documents/projects/zephyr/shd/shd/zephyr/soc/xlnx/zynq7000/Kconfig.sysbuild"
osource "/home/oJis/Documents/projects/zephyr/shd/shd/zephyr/soc/xen/Kconfig.sysbuild"
osource "/home/oJis/Documents/projects/zephyr/shd/shd/zephyr/soc/wch/ch32v/Kconfig.sysbuild"
osource "/home/oJis/Documents/projects/zephyr/shd/shd/zephyr/soc/ti/simplelink/Kconfig.sysbuild"
osource "/home/oJis/Documents/projects/zephyr/shd/shd/zephyr/soc/ti/lm3s6965/Kconfig.sysbuild"
osource "/home/oJis/Documents/projects/zephyr/shd/shd/zephyr/soc/ti/k3/Kconfig.sysbuild"
osource "/home/oJis/Documents/projects/zephyr/shd/shd/zephyr/soc/telink/tlsr/Kconfig.sysbuild"
osource "/home/oJis/Documents/projects/zephyr/shd/shd/zephyr/soc/starfive/jh71xx/Kconfig.sysbuild"
osource "/home/oJis/Documents/projects/zephyr/shd/shd/zephyr/soc/st/stm32/Kconfig.sysbuild"
osource "/home/oJis/Documents/projects/zephyr/shd/shd/zephyr/soc/snps/qemu_arc/Kconfig.sysbuild"
osource "/home/oJis/Documents/projects/zephyr/shd/shd/zephyr/soc/snps/nsim/arc_v/Kconfig.sysbuild"
osource "/home/oJis/Documents/projects/zephyr/shd/shd/zephyr/soc/snps/nsim/arc_classic/Kconfig.sysbuild"
osource "/home/oJis/Documents/projects/zephyr/shd/shd/zephyr/soc/snps/hsdk4xd/Kconfig.sysbuild"
osource "/home/oJis/Documents/projects/zephyr/shd/shd/zephyr/soc/snps/hsdk/Kconfig.sysbuild"
osource "/home/oJis/Documents/projects/zephyr/shd/shd/zephyr/soc/snps/emsk/Kconfig.sysbuild"
osource "/home/oJis/Documents/projects/zephyr/shd/shd/zephyr/soc/snps/emsdp/Kconfig.sysbuild"
osource "/home/oJis/Documents/projects/zephyr/shd/shd/zephyr/soc/snps/arc_iot/Kconfig.sysbuild"
osource "/home/oJis/Documents/projects/zephyr/shd/shd/zephyr/soc/silabs/Kconfig.sysbuild"
osource "/home/oJis/Documents/projects/zephyr/shd/shd/zephyr/soc/sifive/sifive_freedom/Kconfig.sysbuild"
osource "/home/oJis/Documents/projects/zephyr/shd/shd/zephyr/soc/sensry/Kconfig.sysbuild"
osource "/home/oJis/Documents/projects/zephyr/shd/shd/zephyr/soc/rockchip/Kconfig.sysbuild"
osource "/home/oJis/Documents/projects/zephyr/shd/shd/zephyr/soc/renode/riscv_virtual/Kconfig.sysbuild"
osource "/home/oJis/Documents/projects/zephyr/shd/shd/zephyr/soc/renode/cortex_r8_virtual/Kconfig.sysbuild"
osource "/home/oJis/Documents/projects/zephyr/shd/shd/zephyr/soc/renesas/smartbond/Kconfig.sysbuild"
osource "/home/oJis/Documents/projects/zephyr/shd/shd/zephyr/soc/renesas/rzt2m/Kconfig.sysbuild"
osource "/home/oJis/Documents/projects/zephyr/shd/shd/zephyr/soc/renesas/rz/Kconfig.sysbuild"
osource "/home/oJis/Documents/projects/zephyr/shd/shd/zephyr/soc/renesas/rcar/Kconfig.sysbuild"
osource "/home/oJis/Documents/projects/zephyr/shd/shd/zephyr/soc/renesas/ra/Kconfig.sysbuild"
osource "/home/oJis/Documents/projects/zephyr/shd/shd/zephyr/soc/realtek/ec/Kconfig.sysbuild"
osource "/home/oJis/Documents/projects/zephyr/shd/shd/zephyr/soc/raspberrypi/rpi_pico/Kconfig.sysbuild"
osource "/home/oJis/Documents/projects/zephyr/shd/shd/zephyr/soc/quicklogic/eos_s3/Kconfig.sysbuild"
osource "/home/oJis/Documents/projects/zephyr/shd/shd/zephyr/soc/qemu/virt_riscv/Kconfig.sysbuild"
osource "/home/oJis/Documents/projects/zephyr/shd/shd/zephyr/soc/qemu/malta/Kconfig.sysbuild"
osource "/home/oJis/Documents/projects/zephyr/shd/shd/zephyr/soc/openisa/rv32m1/Kconfig.sysbuild"
osource "/home/oJis/Documents/projects/zephyr/shd/shd/zephyr/soc/nxp/s32/Kconfig.sysbuild"
osource "/home/oJis/Documents/projects/zephyr/shd/shd/zephyr/soc/nxp/rw/Kconfig.sysbuild"
osource "/home/oJis/Documents/projects/zephyr/shd/shd/zephyr/soc/nxp/mcx/Kconfig.sysbuild"
osource "/home/oJis/Documents/projects/zephyr/shd/shd/zephyr/soc/nxp/lpc/Kconfig.sysbuild"
osource "/home/oJis/Documents/projects/zephyr/shd/shd/zephyr/soc/nxp/layerscape/Kconfig.sysbuild"
osource "/home/oJis/Documents/projects/zephyr/shd/shd/zephyr/soc/nxp/kinetis/Kconfig.sysbuild"
osource "/home/oJis/Documents/projects/zephyr/shd/shd/zephyr/soc/nxp/imxrt/Kconfig.sysbuild"
osource "/home/oJis/Documents/projects/zephyr/shd/shd/zephyr/soc/nxp/imx/Kconfig.sysbuild"
osource "/home/oJis/Documents/projects/zephyr/shd/shd/zephyr/soc/nuvoton/numicro/Kconfig.sysbuild"
osource "/home/oJis/Documents/projects/zephyr/shd/shd/zephyr/soc/nuvoton/numaker/Kconfig.sysbuild"
osource "/home/oJis/Documents/projects/zephyr/shd/shd/zephyr/soc/nuvoton/npcx/Kconfig.sysbuild"
osource "/home/oJis/Documents/projects/zephyr/shd/shd/zephyr/soc/nuvoton/npcm/Kconfig.sysbuild"
osource "/home/oJis/Documents/projects/zephyr/shd/shd/zephyr/soc/nordic/Kconfig.sysbuild"
osource "/home/oJis/Documents/projects/zephyr/shd/shd/zephyr/soc/neorv32/Kconfig.sysbuild"
osource "/home/oJis/Documents/projects/zephyr/shd/shd/zephyr/soc/native/inf_clock/Kconfig.sysbuild"
osource "/home/oJis/Documents/projects/zephyr/shd/shd/zephyr/soc/microchip/miv/Kconfig.sysbuild"
osource "/home/oJis/Documents/projects/zephyr/shd/shd/zephyr/soc/microchip/mec/Kconfig.sysbuild"
osource "/home/oJis/Documents/projects/zephyr/shd/shd/zephyr/soc/mediatek/mt8xxx/Kconfig.sysbuild"
osource "/home/oJis/Documents/projects/zephyr/shd/shd/zephyr/soc/lowrisc/opentitan/Kconfig.sysbuild"
osource "/home/oJis/Documents/projects/zephyr/shd/shd/zephyr/soc/litex/litex_vexriscv/Kconfig.sysbuild"
osource "/home/oJis/Documents/projects/zephyr/shd/shd/zephyr/soc/ite/ec/Kconfig.sysbuild"
osource "/home/oJis/Documents/projects/zephyr/shd/shd/zephyr/soc/intel/raptor_lake/Kconfig.sysbuild"
osource "/home/oJis/Documents/projects/zephyr/shd/shd/zephyr/soc/intel/lakemont/Kconfig.sysbuild"
osource "/home/oJis/Documents/projects/zephyr/shd/shd/zephyr/soc/intel/intel_socfpga_std/Kconfig.sysbuild"
osource "/home/oJis/Documents/projects/zephyr/shd/shd/zephyr/soc/intel/intel_socfpga/Kconfig.sysbuild"
osource "/home/oJis/Documents/projects/zephyr/shd/shd/zephyr/soc/intel/intel_niosv/Kconfig.sysbuild"
osource "/home/oJis/Documents/projects/zephyr/shd/shd/zephyr/soc/intel/intel_ish/Kconfig.sysbuild"
osource "/home/oJis/Documents/projects/zephyr/shd/shd/zephyr/soc/intel/intel_adsp/Kconfig.sysbuild"
osource "/home/oJis/Documents/projects/zephyr/shd/shd/zephyr/soc/intel/elkhart_lake/Kconfig.sysbuild"
osource "/home/oJis/Documents/projects/zephyr/shd/shd/zephyr/soc/intel/atom/Kconfig.sysbuild"
osource "/home/oJis/Documents/projects/zephyr/shd/shd/zephyr/soc/intel/apollo_lake/Kconfig.sysbuild"
osource "/home/oJis/Documents/projects/zephyr/shd/shd/zephyr/soc/intel/alder_lake/Kconfig.sysbuild"
osource "/home/oJis/Documents/projects/zephyr/shd/shd/zephyr/soc/infineon/cat3/Kconfig.sysbuild"
osource "/home/oJis/Documents/projects/zephyr/shd/shd/zephyr/soc/infineon/cat1b/Kconfig.sysbuild"
osource "/home/oJis/Documents/projects/zephyr/shd/shd/zephyr/soc/infineon/cat1a/Kconfig.sysbuild"
osource "/home/oJis/Documents/projects/zephyr/shd/shd/zephyr/soc/gd/gd32/Kconfig.sysbuild"
osource "/home/oJis/Documents/projects/zephyr/shd/shd/zephyr/soc/gaisler/leon3/Kconfig.sysbuild"
osource "/home/oJis/Documents/projects/zephyr/shd/shd/zephyr/soc/gaisler/gr716a/Kconfig.sysbuild"
osource "/home/oJis/Documents/projects/zephyr/shd/shd/zephyr/soc/espressif/Kconfig.sysbuild"
osource "/home/oJis/Documents/projects/zephyr/shd/shd/zephyr/soc/ene/kb1200/Kconfig.sysbuild"
osource "/home/oJis/Documents/projects/zephyr/shd/shd/zephyr/soc/efinix/sapphire/Kconfig.sysbuild"
osource "/home/oJis/Documents/projects/zephyr/shd/shd/zephyr/soc/cdns/xtensa_sample_controller/Kconfig.sysbuild"
osource "/home/oJis/Documents/projects/zephyr/shd/shd/zephyr/soc/cdns/sample_controller32/Kconfig.sysbuild"
osource "/home/oJis/Documents/projects/zephyr/shd/shd/zephyr/soc/cdns/dc233c/Kconfig.sysbuild"
osource "/home/oJis/Documents/projects/zephyr/shd/shd/zephyr/soc/brcm/bcmvk/Kconfig.sysbuild"
osource "/home/oJis/Documents/projects/zephyr/shd/shd/zephyr/soc/brcm/bcm2712/Kconfig.sysbuild"
osource "/home/oJis/Documents/projects/zephyr/shd/shd/zephyr/soc/brcm/bcm2711/Kconfig.sysbuild"
osource "/home/oJis/Documents/projects/zephyr/shd/shd/zephyr/soc/atmel/sam0/Kconfig.sysbuild"
osource "/home/oJis/Documents/projects/zephyr/shd/shd/zephyr/soc/atmel/sam/Kconfig.sysbuild"
osource "/home/oJis/Documents/projects/zephyr/shd/shd/zephyr/soc/aspeed/Kconfig.sysbuild"
osource "/home/oJis/Documents/projects/zephyr/shd/shd/zephyr/soc/arm/Kconfig.sysbuild"
osource "/home/oJis/Documents/projects/zephyr/shd/shd/zephyr/soc/arm/beetle/Kconfig.sysbuild"
osource "/home/oJis/Documents/projects/zephyr/shd/shd/zephyr/soc/antmicro/myra/Kconfig.sysbuild"
osource "/home/oJis/Documents/projects/zephyr/shd/shd/zephyr/soc/andestech/Kconfig.sysbuild"
osource "/home/oJis/Documents/projects/zephyr/shd/shd/zephyr/soc/amd/acp_6_0/Kconfig.sysbuild"
osource "/home/oJis/Documents/projects/zephyr/shd/shd/zephyr/soc/ambiq/Kconfig.sysbuild"
osource "/home/oJis/Documents/projects/zephyr/shd/shd/zephyr/soc/altr/zephyr_nios2f/Kconfig.sysbuild"
osource "/home/oJis/Documents/projects/zephyr/shd/shd/zephyr/soc/altr/qemu_nios2/Kconfig.sysbuild"
osource "/home/oJis/Documents/projects/zephyr/shd/shd/zephyr/soc/adi/max32/Kconfig.sysbuild"
```
